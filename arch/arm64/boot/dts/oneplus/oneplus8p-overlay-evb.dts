/dts-v1/;
/plugin/;

#include <dt-bindings/clock/qcom,gcc-kona.h>
#include <dt-bindings/clock/qcom,camcc-kona.h>
#include <dt-bindings/clock/qcom,rpmh.h>
#include <dt-bindings/interrupt-controller/arm-gic.h>

#include "qcom/kona-mtp.dtsi"
#include "kona-oem.dtsi"
#include "oneplus8p.dtsi"
#include "oneplus8p_evb.dtsi"
#include "camera/kona-oem-camera-oneplus8p_evb.dtsi"
/ {
	model = "Qualcomm Technologies, Inc. kona MTP evb 19811 55";
	compatible = "qcom,kona-mtp", "qcom,kona", "qcom,mtp";
	qcom,board-id = <8 0>;
	/*we can add project id to this array,uefi can auto read it,if new project,we add to this array */
	oem,project-id = <19811>;
	/*we can add hw id to this array,uefi can auto read it,if new hw,we add to this array  */
	oem,hw-id = <255>; /*only add no use value*/
};

