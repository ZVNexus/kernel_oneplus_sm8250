/dts-v1/;
/plugin/;

#include <dt-bindings/clock/qcom,gcc-kona.h>
#include <dt-bindings/clock/qcom,camcc-kona.h>
#include <dt-bindings/clock/qcom,rpmh.h>
#include <dt-bindings/interrupt-controller/arm-gic.h>

#include "qcom/kona-mtp.dtsi"
#include "kona-oem.dtsi"
#include "oneplus8p.dtsi"
#include "oneplus8p_dvt.dtsi"
#include "camera/kona-oem-camera-oneplus8p_t0.dtsi"
/ {
	model = "Qualcomm Technologies, Inc. kona MTP dvt/mp 19811 14 15 52 53";
	compatible = "qcom,kona-mtp", "qcom,kona", "qcom,mtp";
	qcom,board-id = <8 0>;
	/*we can add project id to this array,uefi can auto read it,if new project,we add to this array */
	oem,project-id = <19811>;
	/*we can add hw id to this array,uefi can auto read it,if new hw,we add to this array  */
	oem,hw-id = <14 15 52 53>;
};

