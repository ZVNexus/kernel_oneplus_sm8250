## drivers/oneplus/Kconfig
```kconfig
source "drivers/oneplus/boot_mode/Kconfig"
source "drivers/oneplus/input/Kconfig"
source "drivers/oneplus/power/Kconfig"
source "drivers/oneplus/project_info/Kconfig"
source "drivers/oneplus/vibrator/Kconfig"
```

## drivers/oneplus/power/supply/Kconfig
```kconfig
source "drivers/power/supply/qcom/Kconfig"
source "drivers/power/supply/wlchg/Kconfig"
```
